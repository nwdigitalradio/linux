## drivers/staging/ad9832/Kconfig
```kconfig
config AD9832
	tristate "Driver for Analog Devices AD9832 devices."
	depends on SPI
	help
		
```

## drivers/staging/adf4360/Kconfig
```kconfig
config ADF4360
	tristate "Driver for Analog Devices AD4360 devices."
	depends on SPI
	depends on OF
	help
		
```

## drivers/staging/cmx991/Kconfig
```kconfig
config CMX991
	tristate "Driver for CML Microcircuits CMX 991 RF Quadrature Transceiver"
	depends on SPI
	help
```
